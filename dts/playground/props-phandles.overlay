/{
    label_a: node_a { 
        compatible = "custom-cells-a";
        #phandle-array-of-ref-cells = <2>;
     };

    label_b: node_b { 
        compatible = "custom-cells-b";
        #phandle-array-of-ref-cells = <1>;
     };

    node_refs {
        compatible = "custom-props-phandles";

        path-by-path = &{/node_a};
        path-by-label = &label_a;

        phandle-by-path = <&{/node_a}>;
        phandle-by-label = <&label_a>;

        // Simple array of phandles
        phandles = <&{/node_a} &label_b>;

        phandle-array-of-refs = <&{/node_a} 1 2 &label_b 1>;
    };
};
