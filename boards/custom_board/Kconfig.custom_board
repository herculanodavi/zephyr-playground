## boards/custom_board/board.yml
```yaml
board:
  name: custom_board
  full_name: Custom board
  vendor: itandroids
  socs:
    - name: stm32f303xe
```

## dts/bindings/custom-props-basics.yaml
```yaml
description: Custom properties
compatible: "custom-props-basics"

properties:
  int:
    type: int
  string:
    type: string
```

## dts/bindings/custom-props-phandles.yaml
```yaml
description: Custom properties
compatible: "custom-props-phandles"

properties:
  path-by-path:
    type: path
  path-by-label:
    type: path
  phandle-by-path:
    type: phandle
  phandle-by-label:
    type: phandle
  phandles:
    type: phandles
  phandle-array-of-refs:
    type: phandle-array
```
